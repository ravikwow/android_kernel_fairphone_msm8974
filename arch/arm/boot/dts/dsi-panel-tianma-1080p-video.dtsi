/* Copyright (c) 2012-2013, The Linux Foundation. All rights reserved.
 *
 * This program is free software; you can redistribute it and/or modify
 * it under the terms of the GNU General Public License version 2 and
 * only version 2 as published by the Free Software Foundation.
 *
 * This program is distributed in the hope that it will be useful,
 * but WITHOUT ANY WARRANTY; without even the implied warranty of
 * MERCHANTABILITY or FITNESS FOR A PARTICULAR PURPOSE.  See the
 * GNU General Public License for more details.
 */

/*---------------------------------------------------------------------------
 * This file is autogenerated file using gcdb parser. Please do not edit it.
 * Update input XML file to add a new entry or update variable in this file
 * VERSION = "1.0"
 *---------------------------------------------------------------------------*/
&mdss_mdp {
	dsi_tianma_1080_vid: qcom,mdss_dsi_tianma_1080p_video {
		qcom,mdss-dsi-panel-name = "Tianma 1080p video mode dsi panel";
		qcom,mdss-dsi-panel-controller = <&mdss_dsi0>;
		qcom,mdss-dsi-panel-type = "dsi_video_mode";
		qcom,mdss-dsi-panel-destination = "display_1";
		qcom,mdss-dsi-panel-framerate = <60>;
		qcom,mdss-dsi-virtual-channel-id = <0>;
		qcom,mdss-dsi-stream = <0>;
		qcom,mdss-dsi-panel-width = <1080>;
		qcom,mdss-dsi-panel-height = <1920>;
		qcom,mdss-dsi-h-front-porch = <100>;
		qcom,mdss-dsi-h-back-porch = <100>;
		qcom,mdss-dsi-h-pulse-width = <4>;
		qcom,mdss-dsi-h-sync-skew = <0>;
		qcom,mdss-dsi-v-front-porch = <6>;
		qcom,mdss-dsi-v-back-porch = <5>;
		qcom,mdss-dsi-v-pulse-width = <2>;
		qcom,mdss-dsi-h-left-border = <0>;
		qcom,mdss-dsi-h-right-border = <0>;
		qcom,mdss-dsi-v-top-border = <0>;
		qcom,mdss-dsi-v-bottom-border = <0>;
		qcom,mdss-dsi-bpp = <24>;
		qcom,mdss-dsi-underflow-color = <0xff>;
		qcom,mdss-dsi-border-color = <0>;
		qcom,mdss-dsi-on-command = [

																
			15 01 00 00 00 00 02 FF 01
			15 01 00 00 00 00 02 FB 01
			15 01 00 00 00 00 02 00 01
			15 01 00 00 00 00 02 01 55
			15 01 00 00 00 00 02 02 40
			15 01 00 00 00 00 02 05 A0
			15 01 00 00 00 00 02 06 0A
			15 01 00 00 00 00 02 07 94
			15 01 00 00 00 00 02 08 0C
			15 01 00 00 00 00 02 0B 73
			15 01 00 00 00 00 02 0C 73
			15 01 00 00 00 00 02 0E 3F
			15 01 00 00 00 00 02 0F 24
			/*
			15 01 00 00 00 00 02 11 1F
			15 01 00 00 00 00 02 13 03
			*/
			15 01 00 00 00 00 02 14 A8
			15 01 00 00 00 00 02 15 1C
			15 01 00 00 00 00 02 16 1C
			15 01 00 00 00 00 02 18 00
			15 01 00 00 00 00 02 19 77
			15 01 00 00 00 00 02 1A 55
			15 01 00 00 00 00 02 1B 13
			15 01 00 00 00 00 02 1C 00
			15 01 00 00 00 00 02 1D 00
			15 01 00 00 00 00 02 1E 13
			15 01 00 00 00 00 02 1F 00
			15 01 00 00 00 00 02 23 00
			15 01 00 00 00 00 02 24 00
			15 01 00 00 00 00 02 25 00
			15 01 00 00 00 00 02 26 00
			15 01 00 00 00 00 02 27 00
			15 01 00 00 00 00 02 28 00
			15 01 00 00 00 00 02 35 00
			15 01 00 00 00 00 02 66 00
			15 01 00 00 00 00 02 58 82
			15 01 00 00 00 00 02 59 02
			15 01 00 00 00 00 02 5A 02
			15 01 00 00 00 00 02 5B 02
			15 01 00 00 00 00 02 5C 82
			15 01 00 00 00 00 02 5D 82
			15 01 00 00 00 00 02 5E 02
			15 01 00 00 00 00 02 5F 02
			15 01 00 00 00 00 02 6D 33
			15 01 00 00 00 00 02 72 31
			15 01 00 00 00 00 02 FF 05
			15 01 00 00 00 00 02 FB 01
			15 01 00 00 00 00 02 00 00
			15 01 00 00 00 00 02 01 00
			15 01 00 00 00 00 02 02 03
			15 01 00 00 00 00 02 03 04
			15 01 00 00 00 00 02 04 00
			15 01 00 00 00 00 02 05 11
			15 01 00 00 00 00 02 06 0C
			15 01 00 00 00 00 02 07 0B
			15 01 00 00 00 00 02 08 01
			15 01 00 00 00 00 02 09 00
			15 01 00 00 00 00 02 0A 18
			15 01 00 00 00 00 02 0B 16
			15 01 00 00 00 00 02 0C 14
			15 01 00 00 00 00 02 0D 17
			15 01 00 00 00 00 02 0E 15
			15 01 00 00 00 00 02 0F 13
			15 01 00 00 00 00 02 10 00
			15 01 00 00 00 00 02 11 00
			15 01 00 00 00 00 02 12 03
			15 01 00 00 00 00 02 13 04
			15 01 00 00 00 00 02 14 00
			15 01 00 00 00 00 02 15 11
			15 01 00 00 00 00 02 16 0C
			15 01 00 00 00 00 02 17 0B
			15 01 00 00 00 00 02 18 01
			15 01 00 00 00 00 02 19 00
			15 01 00 00 00 00 02 1A 18
			15 01 00 00 00 00 02 1B 16
			15 01 00 00 00 00 02 1C 14
			15 01 00 00 00 00 02 1D 17
			15 01 00 00 00 00 02 1E 15
			15 01 00 00 00 00 02 1F 13
			15 01 00 00 00 00 02 20 00
			15 01 00 00 00 00 02 21 02
			15 01 00 00 00 00 02 22 09
			15 01 00 00 00 00 02 23 79
			15 01 00 00 00 00 02 24 00
			15 01 00 00 00 00 02 25 2D
			15 01 00 00 00 00 02 29 58
			15 01 00 00 00 00 02 2A 11
			15 01 00 00 00 00 02 2B 04
			15 01 00 00 00 00 02 2F 02
			15 01 00 00 00 00 02 30 00
			15 01 00 00 00 00 02 31 49
			15 01 00 00 00 00 02 32 23
			15 01 00 00 00 00 02 33 01
			15 01 00 00 00 00 02 34 04
			15 01 00 00 00 00 02 35 76
			15 01 00 00 00 00 02 36 00
			15 01 00 00 00 00 02 37 1D
			15 01 00 00 00 00 02 38 00
			15 01 00 00 00 00 02 5D 23
			15 01 00 00 00 00 02 61 15
			15 01 00 00 00 00 02 65 00
			15 01 00 00 00 00 02 69 04
			15 01 00 00 00 00 02 6C 51
			15 01 00 00 00 00 02 7A 02
			15 01 00 00 00 00 02 7B 80
			15 01 00 00 00 00 02 7C D8
			15 01 00 00 00 00 02 7D 10
			15 01 00 00 00 00 02 7E 09
			15 01 00 00 00 00 02 7F 1F
			15 01 00 00 00 00 02 81 06
			15 01 00 00 00 00 02 82 02
			15 01 00 00 00 00 02 8A 33
			15 01 00 00 00 00 02 93 06
			15 01 00 00 00 00 02 94 06
			15 01 00 00 00 00 02 9B 0F
			15 01 00 00 00 00 02 A4 0F
			15 01 00 00 00 00 02 C5 31
			15 01 00 00 00 00 02 FF 01

			15 01 00 00 00 00 02 FB 01
			15 01 00 00 00 00 02 75 00
			15 01 00 00 00 00 02 76 44
			15 01 00 00 00 00 02 77 00
			15 01 00 00 00 00 02 78 53
			15 01 00 00 00 00 02 79 00
			15 01 00 00 00 00 02 7A 74
			15 01 00 00 00 00 02 7B 00
			15 01 00 00 00 00 02 7C 89
			15 01 00 00 00 00 02 7D 00
			15 01 00 00 00 00 02 7E A1
			15 01 00 00 00 00 02 7F 00
			15 01 00 00 00 00 02 80 B5
			15 01 00 00 00 00 02 81 00
			15 01 00 00 00 00 02 82 C2
			15 01 00 00 00 00 02 83 00
			15 01 00 00 00 00 02 84 CC
			15 01 00 00 00 00 02 85 00
			15 01 00 00 00 00 02 86 D6
			15 01 00 00 00 00 02 87 01
			15 01 00 00 00 00 02 88 04
			15 01 00 00 00 00 02 89 01
			15 01 00 00 00 00 02 8A 29
			15 01 00 00 00 00 02 8B 01
			15 01 00 00 00 00 02 8C 62
			15 01 00 00 00 00 02 8D 01
			15 01 00 00 00 00 02 8E 8D
			15 01 00 00 00 00 02 8F 01
			15 01 00 00 00 00 02 90 D7
			15 01 00 00 00 00 02 91 02
			15 01 00 00 00 00 02 92 15
			15 01 00 00 00 00 02 93 02
			15 01 00 00 00 00 02 94 16
			15 01 00 00 00 00 02 95 02
			15 01 00 00 00 00 02 96 50
			15 01 00 00 00 00 02 97 02
			15 01 00 00 00 00 02 98 8F
			15 01 00 00 00 00 02 99 02
			15 01 00 00 00 00 02 9A B9
			15 01 00 00 00 00 02 9B 02
			15 01 00 00 00 00 02 9C ED
			15 01 00 00 00 00 02 9D 03
			15 01 00 00 00 00 02 9E 13
			15 01 00 00 00 00 02 9F 03
			15 01 00 00 00 00 02 A0 3E
			15 01 00 00 00 00 02 A2 03
			15 01 00 00 00 00 02 A3 4B
			15 01 00 00 00 00 02 A4 03
			15 01 00 00 00 00 02 A5 57
			15 01 00 00 00 00 02 A6 03
			15 01 00 00 00 00 02 A7 68
			15 01 00 00 00 00 02 A9 03
			15 01 00 00 00 00 02 AA 79
			15 01 00 00 00 00 02 AB 03
			15 01 00 00 00 00 02 AC 8F
			15 01 00 00 00 00 02 AD 03
			15 01 00 00 00 00 02 AE AC
			15 01 00 00 00 00 02 AF 03
			15 01 00 00 00 00 02 B0 C7
			15 01 00 00 00 00 02 B1 03
			15 01 00 00 00 00 02 B2 D0
			15 01 00 00 00 00 02 B3 00
			15 01 00 00 00 00 02 B4 44
			15 01 00 00 00 00 02 B5 00
			15 01 00 00 00 00 02 B6 53
			15 01 00 00 00 00 02 B7 00
			15 01 00 00 00 00 02 B8 74
			15 01 00 00 00 00 02 B9 00
			15 01 00 00 00 00 02 BA 89
			15 01 00 00 00 00 02 BB 00
			15 01 00 00 00 00 02 BC A1
			15 01 00 00 00 00 02 BD 00
			15 01 00 00 00 00 02 BE B5
			15 01 00 00 00 00 02 BF 00
			15 01 00 00 00 00 02 C0 C2
			15 01 00 00 00 00 02 C1 00
			15 01 00 00 00 00 02 C2 CC
			15 01 00 00 00 00 02 C3 00
			15 01 00 00 00 00 02 C4 D6
			15 01 00 00 00 00 02 C5 01
			15 01 00 00 00 00 02 C6 04
			15 01 00 00 00 00 02 C7 01
			15 01 00 00 00 00 02 C8 29
			15 01 00 00 00 00 02 C9 01
			15 01 00 00 00 00 02 CA 62
			15 01 00 00 00 00 02 CB 01
			15 01 00 00 00 00 02 CC 8D
			15 01 00 00 00 00 02 CD 01
			15 01 00 00 00 00 02 CE D7
			15 01 00 00 00 00 02 CF 02
			15 01 00 00 00 00 02 D0 15
			15 01 00 00 00 00 02 D1 02
			15 01 00 00 00 00 02 D2 16
			15 01 00 00 00 00 02 D3 02
			15 01 00 00 00 00 02 D4 50
			15 01 00 00 00 00 02 D5 02
			15 01 00 00 00 00 02 D6 8F
			15 01 00 00 00 00 02 D7 02
			15 01 00 00 00 00 02 D8 B9
			15 01 00 00 00 00 02 D9 02
			15 01 00 00 00 00 02 DA ED
			15 01 00 00 00 00 02 DB 03
			15 01 00 00 00 00 02 DC 13
			15 01 00 00 00 00 02 DD 03
			15 01 00 00 00 00 02 DE 3E
			15 01 00 00 00 00 02 DF 03
			15 01 00 00 00 00 02 E0 4B
			15 01 00 00 00 00 02 E1 03
			15 01 00 00 00 00 02 E2 57
			15 01 00 00 00 00 02 E3 03
			15 01 00 00 00 00 02 E4 68
			15 01 00 00 00 00 02 E5 03
			15 01 00 00 00 00 02 E6 79
			15 01 00 00 00 00 02 E7 03
			15 01 00 00 00 00 02 E8 8F
			15 01 00 00 00 00 02 E9 03
			15 01 00 00 00 00 02 EA AC
			15 01 00 00 00 00 02 EB 03
			15 01 00 00 00 00 02 EC C7
			15 01 00 00 00 00 02 ED 03
			15 01 00 00 00 00 02 EE D0
			15 01 00 00 00 00 02 EF 00
			15 01 00 00 00 00 02 F0 C7
			15 01 00 00 00 00 02 F1 00
			15 01 00 00 00 00 02 F2 CC
			15 01 00 00 00 00 02 F3 00
			15 01 00 00 00 00 02 F4 D9
			15 01 00 00 00 00 02 F5 00
			15 01 00 00 00 00 02 F6 E5
			15 01 00 00 00 00 02 F7 00
			15 01 00 00 00 00 02 F8 EF
			15 01 00 00 00 00 02 F9 00
			15 01 00 00 00 00 02 FA F8
			15 01 00 00 00 00 02 FF 02
			15 01 00 00 00 00 02 FB 01
			15 01 00 00 00 00 02 00 01
			15 01 00 00 00 00 02 01 03
			15 01 00 00 00 00 02 02 01
			15 01 00 00 00 00 02 03 0D
			15 01 00 00 00 00 02 04 01
			15 01 00 00 00 00 02 05 15
			15 01 00 00 00 00 02 06 01
			15 01 00 00 00 00 02 07 34
			15 01 00 00 00 00 02 08 01
			15 01 00 00 00 00 02 09 4E
			15 01 00 00 00 00 02 0A 01
			15 01 00 00 00 00 02 0B 7F
			15 01 00 00 00 00 02 0C 01
			15 01 00 00 00 00 02 0D A5
			15 01 00 00 00 00 02 0E 01
			15 01 00 00 00 00 02 0F E6
			15 01 00 00 00 00 02 10 02
			15 01 00 00 00 00 02 11 1E
			15 01 00 00 00 00 02 12 02
			15 01 00 00 00 00 02 13 20
			15 01 00 00 00 00 02 14 02
			15 01 00 00 00 00 02 15 56
			15 01 00 00 00 00 02 16 02
			15 01 00 00 00 00 02 17 95
			15 01 00 00 00 00 02 18 02
			15 01 00 00 00 00 02 19 BD
			15 01 00 00 00 00 02 1A 02
			15 01 00 00 00 00 02 1B F3
			15 01 00 00 00 00 02 1C 03
			15 01 00 00 00 00 02 1D 16
			15 01 00 00 00 00 02 1E 03
			15 01 00 00 00 00 02 1F 42
			15 01 00 00 00 00 02 20 03
			15 01 00 00 00 00 02 21 4A
			15 01 00 00 00 00 02 22 03
			15 01 00 00 00 00 02 23 5A
			15 01 00 00 00 00 02 24 03
			15 01 00 00 00 00 02 25 69
			15 01 00 00 00 00 02 26 03
			15 01 00 00 00 00 02 27 7B
			15 01 00 00 00 00 02 28 03
			15 01 00 00 00 00 02 29 90
			15 01 00 00 00 00 02 2A 03
			15 01 00 00 00 00 02 2B A3
			15 01 00 00 00 00 02 2D 03
			15 01 00 00 00 00 02 2F BD
			15 01 00 00 00 00 02 30 03
			15 01 00 00 00 00 02 31 C4
			15 01 00 00 00 00 02 32 00
			15 01 00 00 00 00 02 33 C7
			15 01 00 00 00 00 02 34 00
			15 01 00 00 00 00 02 35 CC
			15 01 00 00 00 00 02 36 00
			15 01 00 00 00 00 02 37 D9
			15 01 00 00 00 00 02 38 00
			15 01 00 00 00 00 02 39 E5
			15 01 00 00 00 00 02 3A 00
			15 01 00 00 00 00 02 3B EF
			15 01 00 00 00 00 02 3D 00
			15 01 00 00 00 00 02 3F F8
			15 01 00 00 00 00 02 40 01
			15 01 00 00 00 00 02 41 03
			15 01 00 00 00 00 02 42 01
			15 01 00 00 00 00 02 43 0D
			15 01 00 00 00 00 02 44 01
			15 01 00 00 00 00 02 45 15
			15 01 00 00 00 00 02 46 01
			15 01 00 00 00 00 02 47 34
			15 01 00 00 00 00 02 48 01
			15 01 00 00 00 00 02 49 4E
			15 01 00 00 00 00 02 4A 01
			15 01 00 00 00 00 02 4B 7F
			15 01 00 00 00 00 02 4C 01
			15 01 00 00 00 00 02 4D A5
			15 01 00 00 00 00 02 4E 01
			15 01 00 00 00 00 02 4F E6
			15 01 00 00 00 00 02 50 02
			15 01 00 00 00 00 02 51 1E
			15 01 00 00 00 00 02 52 02
			15 01 00 00 00 00 02 53 20
			15 01 00 00 00 00 02 54 02
			15 01 00 00 00 00 02 55 56
			15 01 00 00 00 00 02 56 02
			15 01 00 00 00 00 02 58 95
			15 01 00 00 00 00 02 59 02
			15 01 00 00 00 00 02 5A BD
			15 01 00 00 00 00 02 5B 02
			15 01 00 00 00 00 02 5C F3
			15 01 00 00 00 00 02 5D 03
			15 01 00 00 00 00 02 5E 16
			15 01 00 00 00 00 02 5F 03
			15 01 00 00 00 00 02 60 42
			15 01 00 00 00 00 02 61 03
			15 01 00 00 00 00 02 62 4A
			15 01 00 00 00 00 02 63 03
			15 01 00 00 00 00 02 64 5A
			15 01 00 00 00 00 02 65 03
			15 01 00 00 00 00 02 66 69
			15 01 00 00 00 00 02 67 03
			15 01 00 00 00 00 02 68 7B
			15 01 00 00 00 00 02 69 03
			15 01 00 00 00 00 02 6A 90
			15 01 00 00 00 00 02 6B 03
			15 01 00 00 00 00 02 6C A3
			15 01 00 00 00 00 02 6D 03
			15 01 00 00 00 00 02 6E BD
			15 01 00 00 00 00 02 6F 03
			15 01 00 00 00 00 02 70 C4
			15 01 00 00 00 00 02 71 00
			15 01 00 00 00 00 02 72 B2
			15 01 00 00 00 00 02 73 00
			15 01 00 00 00 00 02 74 B8
			15 01 00 00 00 00 02 75 00
			15 01 00 00 00 00 02 76 C4
			15 01 00 00 00 00 02 77 00
			15 01 00 00 00 00 02 78 D0
			15 01 00 00 00 00 02 79 00
			15 01 00 00 00 00 02 7A DB
			15 01 00 00 00 00 02 7B 00
			15 01 00 00 00 00 02 7C E5
			15 01 00 00 00 00 02 7D 00
			15 01 00 00 00 00 02 7E F1
			15 01 00 00 00 00 02 7F 00
			15 01 00 00 00 00 02 80 F8
			15 01 00 00 00 00 02 81 01
			15 01 00 00 00 00 02 82 03
			15 01 00 00 00 00 02 83 01
			15 01 00 00 00 00 02 84 22
			15 01 00 00 00 00 02 85 01
			15 01 00 00 00 00 02 86 3F
			15 01 00 00 00 00 02 87 01
			15 01 00 00 00 00 02 88 70
			15 01 00 00 00 00 02 89 01
			15 01 00 00 00 00 02 8A 99
			15 01 00 00 00 00 02 8B 01
			15 01 00 00 00 00 02 8C DE
			15 01 00 00 00 00 02 8D 02
			15 01 00 00 00 00 02 8E 19
			15 01 00 00 00 00 02 8F 02
			15 01 00 00 00 00 02 90 1B
			15 01 00 00 00 00 02 91 02
			15 01 00 00 00 00 02 92 53
			15 01 00 00 00 00 02 93 02
			15 01 00 00 00 00 02 94 93
			15 01 00 00 00 00 02 95 02
			15 01 00 00 00 00 02 96 BF
			15 01 00 00 00 00 02 97 02
			15 01 00 00 00 00 02 98 F9
			15 01 00 00 00 00 02 99 03
			15 01 00 00 00 00 02 9A 25
			15 01 00 00 00 00 02 9B 03
			15 01 00 00 00 00 02 9C 67
			15 01 00 00 00 00 02 9D 03
			15 01 00 00 00 00 02 9E 79
			15 01 00 00 00 00 02 9F 03
			15 01 00 00 00 00 02 A0 83
			15 01 00 00 00 00 02 A2 03
			15 01 00 00 00 00 02 A3 95
			15 01 00 00 00 00 02 A4 03
			15 01 00 00 00 00 02 A5 A3
			15 01 00 00 00 00 02 A6 03
			15 01 00 00 00 00 02 A7 B3
			15 01 00 00 00 00 02 A9 03
			15 01 00 00 00 00 02 AA C1
			15 01 00 00 00 00 02 AB 03
			15 01 00 00 00 00 02 AC CD
			15 01 00 00 00 00 02 AD 03
			15 01 00 00 00 00 02 AE D3
			15 01 00 00 00 00 02 AF 00
			15 01 00 00 00 00 02 B0 B2
			15 01 00 00 00 00 02 B1 00
			15 01 00 00 00 00 02 B2 B8
			15 01 00 00 00 00 02 B3 00
			15 01 00 00 00 00 02 B4 C4
			15 01 00 00 00 00 02 B5 00
			15 01 00 00 00 00 02 B6 D0
			15 01 00 00 00 00 02 B7 00
			15 01 00 00 00 00 02 B8 DB
			15 01 00 00 00 00 02 B9 00
			15 01 00 00 00 00 02 BA E5
			15 01 00 00 00 00 02 BB 00
			15 01 00 00 00 00 02 BC F1
			15 01 00 00 00 00 02 BD 00
			15 01 00 00 00 00 02 BE F8
			15 01 00 00 00 00 02 BF 01
			15 01 00 00 00 00 02 C0 03
			15 01 00 00 00 00 02 C1 01
			15 01 00 00 00 00 02 C2 22
			15 01 00 00 00 00 02 C3 01
			15 01 00 00 00 00 02 C4 3F
			15 01 00 00 00 00 02 C5 01
			15 01 00 00 00 00 02 C6 70
			15 01 00 00 00 00 02 C7 01
			15 01 00 00 00 00 02 C8 99
			15 01 00 00 00 00 02 C9 01
			15 01 00 00 00 00 02 CA DE
			15 01 00 00 00 00 02 CB 02
			15 01 00 00 00 00 02 CC 19
			15 01 00 00 00 00 02 CD 02
			15 01 00 00 00 00 02 CE 1B
			15 01 00 00 00 00 02 CF 02
			15 01 00 00 00 00 02 D0 53
			15 01 00 00 00 00 02 D1 02
			15 01 00 00 00 00 02 D2 93
			15 01 00 00 00 00 02 D3 02
			15 01 00 00 00 00 02 D4 BF
			15 01 00 00 00 00 02 D5 02
			15 01 00 00 00 00 02 D6 F9
			15 01 00 00 00 00 02 D7 03
			15 01 00 00 00 00 02 D8 25
			15 01 00 00 00 00 02 D9 03
			15 01 00 00 00 00 02 DA 67
			15 01 00 00 00 00 02 DB 03
			15 01 00 00 00 00 02 DC 79
			15 01 00 00 00 00 02 DD 03
			15 01 00 00 00 00 02 DE 83
			15 01 00 00 00 00 02 DF 03
			15 01 00 00 00 00 02 E0 95
			15 01 00 00 00 00 02 E1 03
			15 01 00 00 00 00 02 E2 A3
			15 01 00 00 00 00 02 E3 03
			15 01 00 00 00 00 02 E4 B3
			15 01 00 00 00 00 02 E5 03
			15 01 00 00 00 00 02 E6 C1
			15 01 00 00 00 00 02 E7 03
			15 01 00 00 00 00 02 E8 CD
			15 01 00 00 00 00 02 E9 03
			15 01 00 00 00 00 02 EA D3

			15 01 00 00 00 00 02 FF 04
			15 01 00 00 00 00 02 08 0C
			15 01 00 00 00 00 02 05 25
			15 01 00 00 00 00 02 FB 01
			15 01 00 00 00 00 02 FF 00
			15 01 00 00 00 00 02 35 01
			15 01 00 00 00 00 02 53 2C
			15 01 00 00 00 00 02 55 00
			15 01 00 00 00 00 02 D3 07
			15 01 00 00 00 00 02 D4 06
			
			15 01 00 00 00 00 02 FF 01
			15 01 00 00 00 00 02 01 55

			15 01 00 00 00 00 02 15 0F
			15 01 00 00 00 00 02 16 0F

			15 01 00 00 00 00 02 1B 1B
			15 01 00 00 00 00 02 1C F7
			15 01 00 00 00 00 02 60 0F
			15 01 00 00 00 00 02 58 82
			15 01 00 00 00 00 02 59 00
			15 01 00 00 00 00 02 5A 02
			15 01 00 00 00 00 02 5B 00
			15 01 00 00 00 00 02 5C 82
			15 01 00 00 00 00 02 5D 80
			15 01 00 00 00 00 02 5E 02
			15 01 00 00 00 00 02 5F 00
			15 01 00 00 00 00 02 66 01
			15 01 00 00 00 00 02 FB 01
			15 01 00 00 00 00 02 FF 05

			15 01 00 00 00 00 02 54 75

			15 01 00 00 00 00 02 85 05
			15 01 00 00 00 00 02 A6 04
			15 01 00 00 00 00 02 FB 01
			15 01 00 00 00 00 02 FF FF
			15 01 00 00 00 00 02 4F 03
			15 01 00 00 00 00 02 FB 01
			15 01 00 00 00 00 02 FF 00
		
/*		
			15 01 00 00 00 00 02 FF 05
			15 01 00 00 00 00 02 86 1B
			15 01 00 00 00 00 02 87 39
			15 01 00 00 00 00 02 88 1B
			15 01 00 00 00 00 02 89 39
			15 01 00 00 00 00 02 8A 33
			15 01 00 00 00 00 02 B5 20
			15 01 00 00 00 00 02 8C 01
			15 01 00 00 00 00 02 FB 01
			15 01 00 00 00 00 02 FF 00
*/
			
			15 01 00 00 00 00 02 36	C0
			
			15 01 00 00 00 00 02 FF 03														
			15 01 00 00 00 00 02 FB 01														
			15 01 00 00 00 00 02 00 64														
			15 01 00 00 00 00 02 01 64														
			15 01 00 00 00 00 02 02 64														
			15 01 00 00 00 00 02 03 64														
			15 01 00 00 00 00 02 04 64														
			15 01 00 00 00 00 02 05 64														
			15 01 00 00 00 00 02 06 60														
			15 01 00 00 00 00 02 07 5C														
			15 01 00 00 00 00 02 08 58														
			15 01 00 00 00 00 02 09 58														
			15 01 00 00 00 00 02 0A 58														
			15 01 00 00 00 00 02 0B 58														
			15 01 00 00 00 00 02 0C 58														
			15 01 00 00 00 00 02 0D 58														
			15 01 00 00 00 00 02 0E 58														
			15 01 00 00 00 00 02 0F 58														
			15 01 00 00 00 00 02 10 2C														
			15 01 00 00 00 00 02 11 00														
			15 01 00 00 00 00 02 12 00														
			15 01 00 00 00 00 02 13 00
			15 01 00 00 00 00 02 1B 64
			15 01 00 00 00 00 02 1C	64
			15 01 00 00 00 00 02 1D 64
			15 01 00 00 00 00 02 1E 64
			15 01 00 00 00 00 02 1F 64
			15 01 00 00 00 00 02 20 64
			15 01 00 00 00 00 02 21 60
			15 01 00 00 00 00 02 22	5C
			15 01 00 00 00 00 02 23 58
			15 01 00 00 00 00 02 24 54
			15 01 00 00 00 00 02 25 50
			15 01 00 00 00 00 02 26 4C
			15 01 00 00 00 00 02 27 48
			15 01 00 00 00 00 02 28	40 
			15 01 00 00 00 00 02 29 34
			15 01 00 00 00 00 02 2A 2C
			15 01 00 00 00 00 02 2B 10
			15 01 00 00 00 00 02 2F 00
			15 01 00 00 00 00 02 30 00
			15 01 00 00 00 00 02 31 00			
			15 01 00 00 00 00 02 32 8C														
			15 01 00 00 00 00 02 33 8A														
			15 01 00 00 00 00 02 34 88														
			15 01 00 00 00 00 02 35 86														
			15 01 00 00 00 00 02 36 84														
			15 01 00 00 00 00 02 37 82														
			15 01 00 00 00 00 02 38 80																										
			15 01 00 00 00 00 02 39 80														
			15 01 00 00 00 00 02 3A 80														
			15 01 00 00 00 00 02 3B 82														
			15 01 00 00 00 00 02 3F 84
			15 01 00 00 00 00 02 40 86	
			15 01 00 00 00 00 02 41 88
			15 01 00 00 00 00 02 42 8A
			15 01 00 00 00 00 02 43 8C
			15 01 00 00 00 00 02 44 8E
			15 01 00 00 00 00 02 45 90
			15 01 00 00 00 00 02 46 92
			15 01 00 00 00 00 02 47 94
			15 01 00 00 00 00 02 48 94
			15 01 00 00 00 00 02 49 94
			15 01 00 00 00 00 02 4A 92
			15 01 00 00 00 00 02 4B 90
			15 01 00 00 00 00 02 4C 8E
			15 01 00 00 00 00 02 4D 00
			15 01 00 00 00 00 02 4E 00
			15 01 00 00 00 00 02 4F 00
			15 01 00 00 00 00 02 50 04
			15 01 00 00 00 00 02 51 08
			15 01 00 00 00 00 02 52 0C
			15 01 00 00 00 00 02 1A 00
			15 01 00 00 00 00 02 53 70
			15 01 00 00 00 00 02 54 20
			15 01 00 00 00 00 02 55 07
			15 01 00 00 00 00 02 5B 00
			15 01 00 00 00 00 02 63 00
			15 01 00 00 00 00 02 FF 00
			
			05 01 00 00 78 00 02 11 00			
			05 01 00 00 32 00 02 29 00


			15 01 00 00 00 00 02 55 02

			];			
		qcom,mdss-dsi-off-command = [
					05 01 00 00 32 00 02 28 00
					05 01 00 00 78 00 02 10 00];			
		qcom,mdss-dsi-on-command-state = "dsi_lp_mode";
		qcom,mdss-dsi-off-command-state = "dsi_hs_mode";
		qcom,mdss-dsi-h-sync-pulse = <0>;
		qcom,mdss-dsi-traffic-mode = "non_burst_sync_event";
		qcom,mdss-dsi-bllp-eof-power-mode;
		qcom,mdss-dsi-bllp-power-mode;
		qcom,mdss-dsi-lane-0-state;
		qcom,mdss-dsi-lane-1-state;
		qcom,mdss-dsi-lane-2-state;
		qcom,mdss-dsi-lane-3-state;
		qcom,mdss-dsi-panel-timings = [e5 38 26 00 69 72
						    2b 3b 41 03 04 00];
		qcom,mdss-dsi-t-clk-post = <0x04>;
		qcom,mdss-dsi-t-clk-pre = <0x1b>;
		qcom,mdss-dsi-bl-min-level = <1>;
		qcom,mdss-dsi-bl-max-level = <255>;
		qcom,mdss-dsi-dma-trigger = "trigger_sw";
		qcom,mdss-dsi-mdp-trigger = "none";
		qcom,mdss-dsi-bl-pmic-control-type = "bl_ctrl_dcs";
		qcom,maker-id-gpio = <&msmgpio 31 1>;//add by niugang10089953
		qcom,mdss-dsi-reset-sequence = <1 3>, <1 3>, <1 3>;
	};
};
