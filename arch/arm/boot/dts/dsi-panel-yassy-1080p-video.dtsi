/* Copyright (c) 2012-2013, The Linux Foundation. All rights reserved.
 *
 * This program is free software; you can redistribute it and/or modify
 * it under the terms of the GNU General Public License version 2 and
 * only version 2 as published by the Free Software Foundation.
 *
 * This program is distributed in the hope that it will be useful,
 * but WITHOUT ANY WARRANTY; without even the implied warranty of
 * MERCHANTABILITY or FITNESS FOR A PARTICULAR PURPOSE.  See the
 * GNU General Public License for more details.
 */

/*---------------------------------------------------------------------------
 * This file is autogenerated file using gcdb parser. Please do not edit it.
 * Update input XML file to add a new entry or update variable in this file
 * VERSION = "1.0"
 *---------------------------------------------------------------------------*/
&mdss_mdp {
	dsi_yassy_1080_vid: qcom,mdss_dsi_yassy_1080p_video {
		qcom,mdss-dsi-panel-name = "Yassy 1080p video mode dsi panel";
		qcom,mdss-dsi-panel-controller = <&mdss_dsi0>;
		qcom,mdss-dsi-panel-type = "dsi_video_mode";
		qcom,mdss-dsi-panel-destination = "display_1";
		qcom,mdss-dsi-panel-framerate = <60>;
		qcom,mdss-dsi-virtual-channel-id = <0>;
		qcom,mdss-dsi-stream = <0>;
		qcom,mdss-dsi-panel-width = <1080>;
		qcom,mdss-dsi-panel-height = <1920>;
		qcom,mdss-dsi-h-front-porch = <100>;
		qcom,mdss-dsi-h-back-porch = <100>;
		qcom,mdss-dsi-h-pulse-width = <4>;
		qcom,mdss-dsi-h-sync-skew = <0>;
		qcom,mdss-dsi-v-front-porch = <4>;
		qcom,mdss-dsi-v-back-porch = <5>;
		qcom,mdss-dsi-v-pulse-width = <2>;
		qcom,mdss-dsi-h-left-border = <0>;
		qcom,mdss-dsi-h-right-border = <0>;
		qcom,mdss-dsi-v-top-border = <0>;
		qcom,mdss-dsi-v-bottom-border = <0>;
		qcom,mdss-dsi-bpp = <24>;
		qcom,mdss-dsi-underflow-color = <0xff>;
		qcom,mdss-dsi-border-color = <0>;
		qcom,mdss-dsi-on-command = [
			15 01 00 00 00 00 02 FF EE
			15 01 00 00 00 00 02 FB 01
			15 01 00 00 00 00 02 24 4f
			15 01 00 00 00 00 02 38	C8
			15 01 00 00 00 00 02 39	27
			15 01 00 00 00 00 02 1E	77
			15 01 00 00 00 00 02 1D	0F
			15 01 00 00 00 00 02 7E	71
			15 01 00 00 00 00 02 7C	03
			15 01 00 00 00 00 02 FF	01
			15 01 00 00 00 00 02 FB	01
			15 01 00 00 00 00 02 00	01
			15 01 00 00 00 00 02 01	55
			15 01 00 00 00 00 02 02	40
			15 01 00 00 00 00 02 05	40
			15 01 00 00 00 00 02 06	4A
			15 01 00 00 00 00 02 07	24
			15 01 00 00 00 00 02 08	0C
			15 01 00 00 00 00 02 0B	7D
			15 01 00 00 00 00 02 0C	7D
			15 01 00 00 00 00 02 0E	B0
			15 01 00 00 00 00 02 0F	AE
			15 01 00 00 00 00 02 11	10
			15 01 00 00 00 00 02 12	10
			15 01 00 00 00 00 02 13	03
			15 01 00 00 00 00 02 14	4A
			15 01 00 00 00 00 02 15	12
			15 01 00 00 00 00 02 16	12
			15 01 00 00 00 00 02 18	00
			15 01 00 00 00 00 02 19	77
			15 01 00 00 00 00 02 1A	55
			15 01 00 00 00 00 02 1B	13
			15 01 00 00 00 00 02 1C	00
			15 01 00 00 00 00 02 1D	00
			15 01 00 00 00 00 02 1E	13
			15 01 00 00 00 00 02 1F	00
			15 01 00 00 00 00 02 23	00
			15 01 00 00 00 00 02 24	00
			15 01 00 00 00 00 02 25	00
			15 01 00 00 00 00 02 26	00
			15 01 00 00 00 00 02 27	00
			15 01 00 00 00 00 02 28	00
			15 01 00 00 00 00 02 35	00
			15 01 00 00 00 00 02 66	00
			15 01 00 00 00 00 02 58	82
			15 01 00 00 00 00 02 59	02
			15 01 00 00 00 00 02 5A	02
			15 01 00 00 00 00 02 5B	02
			15 01 00 00 00 00 02 5C	82
			15 01 00 00 00 00 02 5D	82
			15 01 00 00 00 00 02 5E	02
			15 01 00 00 00 00 02 5F	02
			15 01 00 00 00 00 02 72	31
			15 01 00 00 00 00 02 FF	05
			15 01 00 00 00 00 02 FB	01
			15 01 00 00 00 00 02 00	01
			15 01 00 00 00 00 02 01	0B
			15 01 00 00 00 00 02 02	0C
			15 01 00 00 00 00 02 03	09
			15 01 00 00 00 00 02 04	0A
			15 01 00 00 00 00 02 05	00
			15 01 00 00 00 00 02 06	0F
			15 01 00 00 00 00 02 07	10
			15 01 00 00 00 00 02 08	00
			15 01 00 00 00 00 02 09	00
			15 01 00 00 00 00 02 0A	00
			15 01 00 00 00 00 02 0B	00
			15 01 00 00 00 00 02 0C	00
			15 01 00 00 00 00 02 0D	13
			15 01 00 00 00 00 02 0E	15
			15 01 00 00 00 00 02 0F	17
			15 01 00 00 00 00 02 10	01
			15 01 00 00 00 00 02 11	0B
			15 01 00 00 00 00 02 12	0C
			15 01 00 00 00 00 02 13	09
			15 01 00 00 00 00 02 14	0A
			15 01 00 00 00 00 02 15	00
			15 01 00 00 00 00 02 16	0F
			15 01 00 00 00 00 02 17	10
			15 01 00 00 00 00 02 18	00
			15 01 00 00 00 00 02 19	00
			15 01 00 00 00 00 02 1A	00
			15 01 00 00 00 00 02 1B	00
			15 01 00 00 00 00 02 1C	00
			15 01 00 00 00 00 02 1D	13
			15 01 00 00 00 00 02 1E	15
			15 01 00 00 00 00 02 1F	17
			15 01 00 00 00 00 02 20	00
			15 01 00 00 00 00 02 21	03
			15 01 00 00 00 00 02 22	01
			15 01 00 00 00 00 02 23	40
			15 01 00 00 00 00 02 24	40
			15 01 00 00 00 00 02 25	ED
			15 01 00 00 00 00 02 29	58
			15 01 00 00 00 00 02 2A	12
			15 01 00 00 00 00 02 2B	01
			15 01 00 00 00 00 02 4B	06
			15 01 00 00 00 00 02 4C	11
			15 01 00 00 00 00 02 4D	20
			15 01 00 00 00 00 02 4E	02
			15 01 00 00 00 00 02 4F	02
			15 01 00 00 00 00 02 50	20
			15 01 00 00 00 00 02 51	61
			15 01 00 00 00 00 02 52	01
			15 01 00 00 00 00 02 53	63
			15 01 00 00 00 00 02 54	77
			15 01 00 00 00 00 02 55	ED
			15 01 00 00 00 00 02 5B	00
			15 01 00 00 00 00 02 5C	00
			15 01 00 00 00 00 02 5D	00
			15 01 00 00 00 00 02 5E	00
			15 01 00 00 00 00 02 5F	15
			15 01 00 00 00 00 02 60	75
			15 01 00 00 00 00 02 61	00
			15 01 00 00 00 00 02 62	00
			15 01 00 00 00 00 02 63	00
			15 01 00 00 00 00 02 64	00
			15 01 00 00 00 00 02 65	00
			15 01 00 00 00 00 02 66	00
			15 01 00 00 00 00 02 67	00
			15 01 00 00 00 00 02 68	04
			15 01 00 00 00 00 02 69	00
			15 01 00 00 00 00 02 6A	00
			15 01 00 00 00 00 02 6C	40
			15 01 00 00 00 00 02 75	01
			15 01 00 00 00 00 02 76	01
			15 01 00 00 00 00 02 7A	80
			15 01 00 00 00 00 02 7B	A3
			15 01 00 00 00 00 02 7C	D8
			15 01 00 00 00 00 02 7D	60
			15 01 00 00 00 00 02 7F	15
			15 01 00 00 00 00 02 80	81
			15 01 00 00 00 00 02 83	05
			15 01 00 00 00 00 02 93	08
			15 01 00 00 00 00 02 94	10
			15 01 00 00 00 00 02 8A	00
			15 01 00 00 00 00 02 9B	0F
			    
			15 01 00 00 00 00 02 FF	01
			15 01 00 00 00 00 02 FB	01
			15 01 00 00 00 00 02 75	00
			15 01 00 00 00 00 02 76	9D
			15 01 00 00 00 00 02 77	00
			15 01 00 00 00 00 02 78	A2
			15 01 00 00 00 00 02 79	00
			15 01 00 00 00 00 02 7A	B0
			15 01 00 00 00 00 02 7B	00
			15 01 00 00 00 00 02 7C	BD
			15 01 00 00 00 00 02 7D	00
			15 01 00 00 00 00 02 7E	C9
			15 01 00 00 00 00 02 7F	00
			15 01 00 00 00 00 02 80	D4
			15 01 00 00 00 00 02 81	00
			15 01 00 00 00 00 02 82	DF
			15 01 00 00 00 00 02 83	00
			15 01 00 00 00 00 02 84	E9
			15 01 00 00 00 00 02 85	00
			15 01 00 00 00 00 02 86	F2
			15 01 00 00 00 00 02 87	01
			15 01 00 00 00 00 02 88	17
			15 01 00 00 00 00 02 89	01
			15 01 00 00 00 00 02 8A	36
			15 01 00 00 00 00 02 8B	01
			15 01 00 00 00 00 02 8C	6B
			15 01 00 00 00 00 02 8D	01
			15 01 00 00 00 00 02 8E	98
			15 01 00 00 00 00 02 8F	01
			15 01 00 00 00 00 02 90	E0
			15 01 00 00 00 00 02 91	02
			15 01 00 00 00 00 02 92	19
			15 01 00 00 00 00 02 93	02
			15 01 00 00 00 00 02 94	1A
			15 01 00 00 00 00 02 95	02
			15 01 00 00 00 00 02 96	4E
			15 01 00 00 00 00 02 97	02
			15 01 00 00 00 00 02 98	85
			15 01 00 00 00 00 02 99	02
			15 01 00 00 00 00 02 9A	A9
			15 01 00 00 00 00 02 9B	02
			15 01 00 00 00 00 02 9C	D9
			15 01 00 00 00 00 02 9D	02
			15 01 00 00 00 00 02 9E	FB
			15 01 00 00 00 00 02 9F	03
			15 01 00 00 00 00 02 A0	28
			15 01 00 00 00 00 02 A2	03
			15 01 00 00 00 00 02 A3	35
			15 01 00 00 00 00 02 A4	03
			15 01 00 00 00 00 02 A5	44
			15 01 00 00 00 00 02 A6	03
			15 01 00 00 00 00 02 A7	54
			15 01 00 00 00 00 02 A9	03
			15 01 00 00 00 00 02 AA	67
			15 01 00 00 00 00 02 AB	03
			15 01 00 00 00 00 02 AC	7D
			15 01 00 00 00 00 02 AD	03
			15 01 00 00 00 00 02 AE	91
			15 01 00 00 00 00 02 AF	03
			15 01 00 00 00 00 02 B0	A7
			15 01 00 00 00 00 02 B1	03
			15 01 00 00 00 00 02 B2	CB
			15 01 00 00 00 00 02 B3	00
			15 01 00 00 00 00 02 B4	9D
			15 01 00 00 00 00 02 B5	00
			15 01 00 00 00 00 02 B6	A2
			15 01 00 00 00 00 02 B7	00
			15 01 00 00 00 00 02 B8	B0
			15 01 00 00 00 00 02 B9	00
			15 01 00 00 00 00 02 BA	BD
			15 01 00 00 00 00 02 BB	00
			15 01 00 00 00 00 02 BC	C9
			15 01 00 00 00 00 02 BD	00
			15 01 00 00 00 00 02 BE	D4
			15 01 00 00 00 00 02 BF	00
			15 01 00 00 00 00 02 C0	DF
			15 01 00 00 00 00 02 C1	00
			15 01 00 00 00 00 02 C2	E9
			15 01 00 00 00 00 02 C3	00
			15 01 00 00 00 00 02 C4	F2
			15 01 00 00 00 00 02 C5	01
			15 01 00 00 00 00 02 C6	17
			15 01 00 00 00 00 02 C7	01
			15 01 00 00 00 00 02 C8	36
			15 01 00 00 00 00 02 C9	01
			15 01 00 00 00 00 02 CA	6B
			15 01 00 00 00 00 02 CB	01
			15 01 00 00 00 00 02 CC	98
			15 01 00 00 00 00 02 CD	01
			15 01 00 00 00 00 02 CE	E0
			15 01 00 00 00 00 02 CF	02
			15 01 00 00 00 00 02 D0	19
			15 01 00 00 00 00 02 D1	02
			15 01 00 00 00 00 02 D2	1A
			15 01 00 00 00 00 02 D3	02
			15 01 00 00 00 00 02 D4	4E
			15 01 00 00 00 00 02 D5	02
			15 01 00 00 00 00 02 D6	85
			15 01 00 00 00 00 02 D7	02
			15 01 00 00 00 00 02 D8	A9
			15 01 00 00 00 00 02 D9	02
			15 01 00 00 00 00 02 DA	D9
			15 01 00 00 00 00 02 DB	02
			
			15 01 00 00 00 00 02 DC	FB
			15 01 00 00 00 00 02 DD	03
			15 01 00 00 00 00 02 DE	28
			15 01 00 00 00 00 02 DF	03
			15 01 00 00 00 00 02 E0	35
			15 01 00 00 00 00 02 E1	03
			15 01 00 00 00 00 02 E2	44
			15 01 00 00 00 00 02 E3	03
			15 01 00 00 00 00 02 E4	54
			15 01 00 00 00 00 02 E5	03
			15 01 00 00 00 00 02 E6	67
			15 01 00 00 00 00 02 E7	03
			15 01 00 00 00 00 02 E8	7D
			15 01 00 00 00 00 02 E9	03
			15 01 00 00 00 00 02 EA	91
			15 01 00 00 00 00 02 EB	03
			15 01 00 00 00 00 02 EC	A7
			15 01 00 00 00 00 02 ED	03
			15 01 00 00 00 00 02 EE	CB
			15 01 00 00 00 00 02 EF	00
			15 01 00 00 00 00 02 F0	7D
			15 01 00 00 00 00 02 F1	00
			15 01 00 00 00 00 02 F2	81
			15 01 00 00 00 00 02 F3	00
			15 01 00 00 00 00 02 F4	94
			15 01 00 00 00 00 02 F5	00
			15 01 00 00 00 00 02 F6	A2
			15 01 00 00 00 00 02 F7	00
			15 01 00 00 00 00 02 F8	AF
			15 01 00 00 00 00 02 F9	00
			15 01 00 00 00 00 02 FA	BC
			15 01 00 00 00 00 02 FF	02
			15 01 00 00 00 00 02 FB	01
			15 01 00 00 00 00 02 00	00
			15 01 00 00 00 00 02 01	C8
			15 01 00 00 00 00 02 02	00
			15 01 00 00 00 00 02 03	D4
			15 01 00 00 00 00 02 04	00
			15 01 00 00 00 00 02 05	DF
			15 01 00 00 00 00 02 06	01
			15 01 00 00 00 00 02 07	06
			15 01 00 00 00 00 02 08	01
			15 01 00 00 00 00 02 09	28
			15 01 00 00 00 00 02 0A	01
			15 01 00 00 00 00 02 0B	61
			15 01 00 00 00 00 02 0C	01
			15 01 00 00 00 00 02 0D	8F
			15 01 00 00 00 00 02 0E	01
			15 01 00 00 00 00 02 0F	DA
			15 01 00 00 00 00 02 10	02
			15 01 00 00 00 00 02 11	15
			15 01 00 00 00 00 02 12	02
			15 01 00 00 00 00 02 13	17
			15 01 00 00 00 00 02 14	02
			15 01 00 00 00 00 02 15	4C
			15 01 00 00 00 00 02 16	02
			15 01 00 00 00 00 02 17	83
			15 01 00 00 00 00 02 18	02
			15 01 00 00 00 00 02 19	A7
			15 01 00 00 00 00 02 1A	02
			15 01 00 00 00 00 02 1B	D8
			15 01 00 00 00 00 02 1C	02
			15 01 00 00 00 00 02 1D	FA
			15 01 00 00 00 00 02 1E	03
			15 01 00 00 00 00 02 1F	27
			15 01 00 00 00 00 02 20	03
			15 01 00 00 00 00 02 21	35
			15 01 00 00 00 00 02 22	03
			15 01 00 00 00 00 02 23	44
			15 01 00 00 00 00 02 24	03
			15 01 00 00 00 00 02 25	55
			15 01 00 00 00 00 02 26	03
			15 01 00 00 00 00 02 27	67
			15 01 00 00 00 00 02 28	03
			15 01 00 00 00 00 02 29	7F
			15 01 00 00 00 00 02 2A	03
			15 01 00 00 00 00 02 2B	92
			15 01 00 00 00 00 02 2D	03
			15 01 00 00 00 00 02 2F	AA
			15 01 00 00 00 00 02 30	03
			15 01 00 00 00 00 02 31	CB
			15 01 00 00 00 00 02 32	00
			15 01 00 00 00 00 02 33	7D
			15 01 00 00 00 00 02 34	00
			15 01 00 00 00 00 02 35	81
			15 01 00 00 00 00 02 36	00
			15 01 00 00 00 00 02 37	94
			15 01 00 00 00 00 02 38	00
			15 01 00 00 00 00 02 39	A2
			15 01 00 00 00 00 02 3A	00
			15 01 00 00 00 00 02 3B	AF
			15 01 00 00 00 00 02 3D	00
			15 01 00 00 00 00 02 3F	BC
			15 01 00 00 00 00 02 40	00
			15 01 00 00 00 00 02 41	C8
			15 01 00 00 00 00 02 42	00
			15 01 00 00 00 00 02 43	D4
			15 01 00 00 00 00 02 44	00
			15 01 00 00 00 00 02 45	DF
			15 01 00 00 00 00 02 46	01
			15 01 00 00 00 00 02 47	06
			15 01 00 00 00 00 02 48	01
			15 01 00 00 00 00 02 49	28
			15 01 00 00 00 00 02 4A	01
			15 01 00 00 00 00 02 4B	61
			15 01 00 00 00 00 02 4C	01
			15 01 00 00 00 00 02 4D	8F
			15 01 00 00 00 00 02 4E	01
			15 01 00 00 00 00 02 4F	DA
			15 01 00 00 00 00 02 50	02
			15 01 00 00 00 00 02 51	15
			15 01 00 00 00 00 02 52	02
			15 01 00 00 00 00 02 53	17
			15 01 00 00 00 00 02 54	02
			15 01 00 00 00 00 02 55	4C
			15 01 00 00 00 00 02 56	02
			15 01 00 00 00 00 02 58	83
			15 01 00 00 00 00 02 59	02
			15 01 00 00 00 00 02 5A	A7
			15 01 00 00 00 00 02 5B	02
			15 01 00 00 00 00 02 5C	D8
			15 01 00 00 00 00 02 5D	02
			15 01 00 00 00 00 02 5E	FA
			15 01 00 00 00 00 02 5F	03
			15 01 00 00 00 00 02 60	27
			15 01 00 00 00 00 02 61	03
			15 01 00 00 00 00 02 62	35
			15 01 00 00 00 00 02 63	03
			15 01 00 00 00 00 02 64	44
			15 01 00 00 00 00 02 65	03
			15 01 00 00 00 00 02 66	55
			15 01 00 00 00 00 02 67	03
			15 01 00 00 00 00 02 68	67
			15 01 00 00 00 00 02 69	03
			15 01 00 00 00 00 02 6A	7F
			15 01 00 00 00 00 02 6B	03
			15 01 00 00 00 00 02 6C	92
			15 01 00 00 00 00 02 6D	03
			15 01 00 00 00 00 02 6E	AA
			15 01 00 00 00 00 02 6F	03
			15 01 00 00 00 00 02 70	CB
			15 01 00 00 00 00 02 71	00
			15 01 00 00 00 00 02 72	00
			15 01 00 00 00 00 02 73	00
			15 01 00 00 00 00 02 74	21
			15 01 00 00 00 00 02 75	00
			15 01 00 00 00 00 02 76	4C
			15 01 00 00 00 00 02 77	00
			15 01 00 00 00 00 02 78	6B
			15 01 00 00 00 00 02 79	00
			15 01 00 00 00 00 02 7A	85
			15 01 00 00 00 00 02 7B	00
			15 01 00 00 00 00 02 7C	9A
			15 01 00 00 00 00 02 7D	00
			15 01 00 00 00 00 02 7E	AD
			15 01 00 00 00 00 02 7F	00
			15 01 00 00 00 00 02 80	BE
			15 01 00 00 00 00 02 81	00
			15 01 00 00 00 00 02 82	CD
			15 01 00 00 00 00 02 83	01
			15 01 00 00 00 00 02 84	01
			15 01 00 00 00 00 02 85	01
			15 01 00 00 00 00 02 86	29
			15 01 00 00 00 00 02 87	01
			15 01 00 00 00 00 02 88	68
			15 01 00 00 00 00 02 89	01
			15 01 00 00 00 00 02 8A	98
			15 01 00 00 00 00 02 8B	01
			15 01 00 00 00 00 02 8C	E5
			15 01 00 00 00 00 02 8D	02
			15 01 00 00 00 00 02 8E	1E
			15 01 00 00 00 00 02 8F	02
			15 01 00 00 00 00 02 90	20
			15 01 00 00 00 00 02 91	02
			15 01 00 00 00 00 02 92	52
			15 01 00 00 00 00 02 93	02
			15 01 00 00 00 00 02 94	88
			15 01 00 00 00 00 02 95	02
			15 01 00 00 00 00 02 96	AA
			15 01 00 00 00 00 02 97	02
			15 01 00 00 00 00 02 98	D7
			15 01 00 00 00 00 02 99	02
			15 01 00 00 00 00 02 9A	F7
			15 01 00 00 00 00 02 9B	03
			15 01 00 00 00 00 02 9C	21
			15 01 00 00 00 00 02 9D	03
			15 01 00 00 00 00 02 9E	2E
			15 01 00 00 00 00 02 9F	03
			15 01 00 00 00 00 02 A0	3D
			15 01 00 00 00 00 02 A2	03
			15 01 00 00 00 00 02 A3	4C
			15 01 00 00 00 00 02 A4	03
			15 01 00 00 00 00 02 A5	5E
			15 01 00 00 00 00 02 A6	03
			15 01 00 00 00 00 02 A7	71
			15 01 00 00 00 00 02 A9	03
			15 01 00 00 00 00 02 AA	86
			15 01 00 00 00 00 02 AB	03
			15 01 00 00 00 00 02 AC	94
			15 01 00 00 00 00 02 AD	03
			15 01 00 00 00 00 02 AE	FA
			15 01 00 00 00 00 02 AF	00
			15 01 00 00 00 00 02 B0	00
			15 01 00 00 00 00 02 B1	00
			15 01 00 00 00 00 02 B2	21
			15 01 00 00 00 00 02 B3	00
			15 01 00 00 00 00 02 B4	4C
			15 01 00 00 00 00 02 B5	00
			15 01 00 00 00 00 02 B6	6B
			15 01 00 00 00 00 02 B7	00
			15 01 00 00 00 00 02 B8	85
			15 01 00 00 00 00 02 B9	00
			15 01 00 00 00 00 02 BA	9A
			15 01 00 00 00 00 02 BB	00
			15 01 00 00 00 00 02 BC	AD
			15 01 00 00 00 00 02 BD	00
			15 01 00 00 00 00 02 BE	BE
			15 01 00 00 00 00 02 BF	00
			15 01 00 00 00 00 02 C0	CD
			15 01 00 00 00 00 02 C1	01
			15 01 00 00 00 00 02 C2	01
			15 01 00 00 00 00 02 C3	01
			15 01 00 00 00 00 02 C4	29
			15 01 00 00 00 00 02 C5	01
			15 01 00 00 00 00 02 C6	68
			15 01 00 00 00 00 02 C7	01
			15 01 00 00 00 00 02 C8	98
			15 01 00 00 00 00 02 C9	01
			15 01 00 00 00 00 02 CA	E5
			15 01 00 00 00 00 02 CB	02
			15 01 00 00 00 00 02 CC	1E
			15 01 00 00 00 00 02 CD	02
			15 01 00 00 00 00 02 CE	20
			15 01 00 00 00 00 02 CF	02
			15 01 00 00 00 00 02 D0	52
			15 01 00 00 00 00 02 D1	02
			15 01 00 00 00 00 02 D2	88
			15 01 00 00 00 00 02 D3	02
			15 01 00 00 00 00 02 D4	AA
			15 01 00 00 00 00 02 D5	02
			15 01 00 00 00 00 02 D6	D7
			15 01 00 00 00 00 02 D7	02
			15 01 00 00 00 00 02 D8	F7
			15 01 00 00 00 00 02 D9	03
			15 01 00 00 00 00 02 DA	21
			15 01 00 00 00 00 02 DB	03
			15 01 00 00 00 00 02 DC	2E
			15 01 00 00 00 00 02 DD	03
			15 01 00 00 00 00 02 DE	3D
			15 01 00 00 00 00 02 DF	03
			15 01 00 00 00 00 02 E0	4C
			15 01 00 00 00 00 02 E1	03
			15 01 00 00 00 00 02 E2	5E
			15 01 00 00 00 00 02 E3	03
			15 01 00 00 00 00 02 E4	71
			15 01 00 00 00 00 02 E5	03
			15 01 00 00 00 00 02 E6	86
			15 01 00 00 00 00 02 E7	03
			15 01 00 00 00 00 02 E8	94
			15 01 00 00 00 00 02 E9	03
			15 01 00 00 00 00 02 EA	FA


			/* ZTE_MODIFY zhaochenwei for ce initial para begin 0909 */
			15 01 00 00 00 00 02 FF 03														
			15 01 00 00 00 00 02 FB 01														
			15 01 00 00 00 00 02 00 64														
			15 01 00 00 00 00 02 01 64														
			15 01 00 00 00 00 02 02 64														
			15 01 00 00 00 00 02 03 64														
			15 01 00 00 00 00 02 04 64														
			15 01 00 00 00 00 02 05 64														
			15 01 00 00 00 00 02 06 60														
			15 01 00 00 00 00 02 07 5C														
			15 01 00 00 00 00 02 08 58														
			15 01 00 00 00 00 02 09 58														
			15 01 00 00 00 00 02 0A 58														
			15 01 00 00 00 00 02 0B 58														
			15 01 00 00 00 00 02 0C 58														
			15 01 00 00 00 00 02 0D 58														
			15 01 00 00 00 00 02 0E 58														
			15 01 00 00 00 00 02 0F 58														
			15 01 00 00 00 00 02 10 2C														
			15 01 00 00 00 00 02 11 00														
			15 01 00 00 00 00 02 12 00														
			15 01 00 00 00 00 02 13 00
			15 01 00 00 00 00 02 1B 64
			15 01 00 00 00 00 02 1C	64
			15 01 00 00 00 00 02 1D 64
			15 01 00 00 00 00 02 1E 64
			15 01 00 00 00 00 02 1F 64
			15 01 00 00 00 00 02 20 64
			15 01 00 00 00 00 02 21 60
			15 01 00 00 00 00 02 22	5C
			15 01 00 00 00 00 02 23 58
			15 01 00 00 00 00 02 24 54
			15 01 00 00 00 00 02 25 50
			15 01 00 00 00 00 02 26 4C
			15 01 00 00 00 00 02 27 48
			15 01 00 00 00 00 02 28	40 
			15 01 00 00 00 00 02 29 34
			15 01 00 00 00 00 02 2A 2C
			15 01 00 00 00 00 02 2B 10
			15 01 00 00 00 00 02 2F 00
			15 01 00 00 00 00 02 30 00
			15 01 00 00 00 00 02 31 00			
			15 01 00 00 00 00 02 32 8C														
			15 01 00 00 00 00 02 33 8A														
			15 01 00 00 00 00 02 34 88														
			15 01 00 00 00 00 02 35 86														
			15 01 00 00 00 00 02 36 84														
			15 01 00 00 00 00 02 37 82														
			15 01 00 00 00 00 02 38 80																										
			15 01 00 00 00 00 02 39 80														
			15 01 00 00 00 00 02 3A 80														
			15 01 00 00 00 00 02 3B 82														
			15 01 00 00 00 00 02 3F 84
			15 01 00 00 00 00 02 40 86	
			15 01 00 00 00 00 02 41 88
			15 01 00 00 00 00 02 42 8A
			15 01 00 00 00 00 02 43 8C
			15 01 00 00 00 00 02 44 8E
			15 01 00 00 00 00 02 45 90
			15 01 00 00 00 00 02 46 92
			15 01 00 00 00 00 02 47 94
			15 01 00 00 00 00 02 48 94
			15 01 00 00 00 00 02 49 94
			15 01 00 00 00 00 02 4A 92
			15 01 00 00 00 00 02 4B 90
			15 01 00 00 00 00 02 4C 8E
			15 01 00 00 00 00 02 4D 00
			15 01 00 00 00 00 02 4E 00
			15 01 00 00 00 00 02 4F 00
			15 01 00 00 00 00 02 50 04
			15 01 00 00 00 00 02 51 08
			15 01 00 00 00 00 02 52 0C
			15 01 00 00 00 00 02 1A 00
			15 01 00 00 00 00 02 53 70
			15 01 00 00 00 00 02 54 20
			15 01 00 00 00 00 02 55 07
			15 01 00 00 00 00 02 5B 00
			15 01 00 00 00 00 02 63 00
			15 01 00 00 00 00 02 FF 00
			/* ZTE_MODIFY zhaochenwei for ce initial para end 0909 */
			
			15 01 00 00 00 00 02 FF	01
			15 01 00 00 00 00 02 FB	01
			15 01 00 00 00 00 02 FF	02
			15 01 00 00 00 00 02 FB	01
			/* ZTE_MODIFY zhaochenwei for ce initial para begin 0909 */
      15 01 00 00 00 00 02 FF	03
			15 01 00 00 00 00 02 FB	01
			/* ZTE_MODIFY zhaochenwei for ce initial para end 0909 */
			15 01 00 00 00 00 02 FF	04
			15 01 00 00 00 00 02 FB	01
			
			15 01 00 00 00 00 02 08	0C
			15 01 00 00 00 00 02 05	25
			

			15 01 00 00 00 00 02 FF	00
			15 01 00 00 00 00 02 FB	01
			
			15 01 00 00 00 00 02 36	C0
			
			15 01 00 00 00 00 02 D3	07
			15 01 00 00 00 00 02 D4	04
			
			15 01 00 00 00 00 02 FF 01
			15 01 00 00 00 00 02 01 55
			15 01 00 00 00 00 02 15 0F
			15 01 00 00 00 00 02 16 0F
			15 01 00 00 00 00 02 1B 1B
			15 01 00 00 00 00 02 1C F7
			15 01 00 00 00 00 02 60 0F
			15 01 00 00 00 00 02 58 82
			15 01 00 00 00 00 02 59 00
			15 01 00 00 00 00 02 5A 02
			15 01 00 00 00 00 02 5B 00
			15 01 00 00 00 00 02 5C 82
			15 01 00 00 00 00 02 5D 80
			15 01 00 00 00 00 02 5E 02
			15 01 00 00 00 00 02 5F 00
			15 01 00 00 00 00 02 66 01
			15 01 00 00 00 00 02 FB 01
			15 01 00 00 00 00 02 FF 05
			15 01 00 00 00 00 02 54 75
			15 01 00 00 00 00 02 85 05
			15 01 00 00 00 00 02 A6 04
			15 01 00 00 00 00 02 FB 01
			15 01 00 00 00 00 02 FF FF
			15 01 00 00 00 00 02 4F 03
			15 01 00 00 00 00 02 FB 01
			15 01 00 00 00 00 02 FF 00
			15 01 00 00 00 00 02 FF 00
			15 01 00 00 00 00 02 FB 01
			
			15 01 00 00 00 00 02 FF 05
			15 01 00 00 00 00 02 86 1B
			15 01 00 00 00 00 02 87 39
			15 01 00 00 00 00 02 88 1B
			15 01 00 00 00 00 02 89 39
			15 01 00 00 00 00 02 8A 00
			15 01 00 00 00 00 02 B5 20
			15 01 00 00 00 00 02 8C 01
			15 01 00 00 00 00 02 FB 01
			15 01 00 00 00 00 02 FF 00
			
			05 01 00 00 78 00 02 11 00			
			05 01 00 00 32 00 02 29 00	
			
			15 01 00 00 00 00 02 55 02
			
			];			
		qcom,mdss-dsi-off-command = [
					05 01 00 00 32 00 02 28 00
					05 01 00 00 78 00 02 10 00];			
		qcom,mdss-dsi-on-command-state = "dsi_lp_mode";
		qcom,mdss-dsi-off-command-state = "dsi_hs_mode";
		qcom,mdss-dsi-h-sync-pulse = <0>;
		qcom,mdss-dsi-traffic-mode = "non_burst_sync_event";
		qcom,mdss-dsi-bllp-eof-power-mode;
		qcom,mdss-dsi-bllp-power-mode;
		qcom,mdss-dsi-lane-0-state;
		qcom,mdss-dsi-lane-1-state;
		qcom,mdss-dsi-lane-2-state;
		qcom,mdss-dsi-lane-3-state;
		qcom,mdss-dsi-panel-timings = [e5 38 26 00 69 72
						    2b 3b 41 03 04 00];
		qcom,mdss-dsi-t-clk-post = <0x04>;
		qcom,mdss-dsi-t-clk-pre = <0x1b>;
		qcom,mdss-dsi-bl-min-level = <1>;
		qcom,mdss-dsi-bl-max-level = <255>;
		qcom,mdss-dsi-dma-trigger = "trigger_sw";
		qcom,mdss-dsi-mdp-trigger = "none";
		qcom,mdss-dsi-bl-pmic-control-type = "bl_ctrl_dcs";
		qcom,maker-id-gpio = <&msmgpio 31 1>;//add by niugang10089953
		qcom,mdss-dsi-reset-sequence = <1 3>, <1 3>, <1 3>;
	};
};
